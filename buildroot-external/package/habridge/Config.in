## buildroot-external/package/habridge/Config.in
```kconfig
config BR2_PACKAGE_HABRIDGE
	bool "HA Bridge"
	depends on BR2_PACKAGE_JAVA_AZUL # fork()
	help
	  Home automation bridge that emulates a Philips Hue light system
	  and can control other systems such as a Vera, Harmony Hub, Nest,
	  MiLight bulbs or any other system that has an http/https/tcp/udp
	  interface.
	  This is a compact impl to run on small format computers.
	  This is impl started from this project
	  https://github.com/armzilla/amazon-echo-ha-bridge
```
